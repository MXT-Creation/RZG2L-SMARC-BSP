## meta-mxt-rzg2l/conf/layer.conf
```bitbake
# We have a conf and classes directory, add to BBPATH

BBPATH .= ":${LAYERDIR}"

BBFILE_COLLECTIONS += "mxt-rzg2l"
BBFILE_PATTERN_mxt-rzg2l := "^${LAYERDIR}/"

BBFILE_PRIORITY_mxt-rzg2l = "20"

# We have recipes-* directories, add to BBFILES
BBFILES += "${LAYERDIR}/recipes-*/*/*.bb \
    ${LAYERDIR}/recipes-*/*.bb \
    ${LAYERDIR}/recipes-*/*.bbappend \
    ${LAYERDIR}/recipes-*/*/*.bbappend"
```

## meta-rz-browser/conf/layer.conf
```bitbake
# We have a conf and classes directory, add to BBPATH
BBPATH .= ":${LAYERDIR}"

# We have recipes-* directories, add to BBFILES
BBFILES += "${LAYERDIR}/recipes-*/*/*.bb \
            ${LAYERDIR}/recipes-*/*/*.bbappend"

BBFILES_DYNAMIC += " \
    rz-graphics:${LAYERDIR}/dynamic-layers/rz-graphics/*/*.bb \
    rz-graphics:${LAYERDIR}/dynamic-layers/rz-graphics/*/*.bbappend \
"

BBFILE_COLLECTIONS += "rz-browser"
BBFILE_PATTERN_rz-browser := "^${LAYERDIR}/"

LAYERDEPENDS_rz-browser = "rz-common browser-layer"
LAYERSERIES_COMPAT_rz-browser = "dunfell"

BBMASK_append_rzg2l = " dynamic-layers/rz-graphics/mesa"
```
